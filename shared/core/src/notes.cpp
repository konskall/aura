#include "aura/notes.hpp"

#include "aura/text_util.hpp"

#include <algorithm>
#include <chrono>
#include <cstdio>
#include <sstream>

namespace aura {
namespace {

bool parse_number(const std::string& text, std::int64_t& value) {
    if (text.empty() || text.size() > 18) return false;
    std::int64_t result = 0;
    for (const char ch : text) {
        if (ch < '0' || ch > '9') return false;
        result = result * 10 + (ch - '0');
    }
    value = result;
    return true;
}

// Audio file names are generated by the platform; anything else is refused so
// a corrupted store cannot point outside the notes folder.
bool safe_audio_name(const std::string& name) {
    if (name.empty()) return true;
    if (name.size() > 64) return false;
    return std::all_of(name.begin(), name.end(), [](char ch) {
        return (ch >= 'a' && ch <= 'z') || (ch >= '0' && ch <= '9') || ch == '-' || ch == '_' || ch == '.';
    }) && name.find("..") == std::string::npos;
}

// Notes may hold several lines; the store keeps one note per line.
std::string escape_line(const std::string& text) {
    std::string output;
    for (const char ch : text) {
        if (ch == '\\') output += "\\\\";
        else if (ch == '\n') output += "\\n";
        else if (ch == '\t') output += "\\t";
        else output.push_back(ch);
    }
    return output;
}

std::string unescape_line(const std::string& text) {
    std::string output;
    for (std::size_t index = 0; index < text.size(); ++index) {
        if (text[index] != '\\' || index + 1 >= text.size()) {
            output.push_back(text[index]);
            continue;
        }
        const char next = text[++index];
        output.push_back(next == 'n' ? '\n' : (next == 't' ? '\t' : next));
    }
    return output;
}

}  // namespace

NoteResult NotesModel::add_text(const std::string& text, std::int64_t created_minute, std::uint32_t* id) {
    auto clean = sanitize_text(text, kMaxTextBytes, true);
    if (clean.empty()) return NoteResult::Empty;
    if (snapshot_.notes.size() >= kMaxNotes) return NoteResult::Full;
    NoteItem note;
    note.id = next_id_++;
    note.created_minute = created_minute;
    note.text = std::move(clean);
    snapshot_.notes.insert(snapshot_.notes.begin(), std::move(note));
    if (id) *id = snapshot_.notes.front().id;
    changed();
    return NoteResult::Ok;
}

NoteResult NotesModel::add_voice(const std::string& audio_file, std::uint32_t audio_ms, std::int64_t created_minute,
                                 std::uint32_t* id) {
    if (audio_file.empty() || !safe_audio_name(audio_file)) return NoteResult::Empty;
    if (snapshot_.notes.size() >= kMaxNotes) return NoteResult::Full;
    NoteItem note;
    note.id = next_id_++;
    note.created_minute = created_minute;
    note.audio_file = audio_file;
    note.audio_ms = audio_ms;
    note.transcript = NoteTranscript::Pending;
    snapshot_.notes.insert(snapshot_.notes.begin(), std::move(note));
    if (id) *id = snapshot_.notes.front().id;
    changed();
    return NoteResult::Ok;
}

NoteResult NotesModel::set_transcript(std::uint32_t id, const std::string& text) {
    auto* note = find_mutable(id);
    if (!note) return NoteResult::NotFound;
    auto clean = sanitize_text(text, kMaxTextBytes, true);
    if (clean.empty()) return set_transcript_failed(id);
    note->text = std::move(clean);
    note->transcript = NoteTranscript::Ready;
    changed();
    return NoteResult::Ok;
}

NoteResult NotesModel::set_transcript_failed(std::uint32_t id) {
    auto* note = find_mutable(id);
    if (!note) return NoteResult::NotFound;
    note->transcript = NoteTranscript::Failed;
    changed();
    return NoteResult::Ok;
}

NoteResult NotesModel::remove(std::uint32_t id, std::string* removed_audio_file) {
    auto& notes = snapshot_.notes;
    const auto found = std::find_if(notes.begin(), notes.end(), [id](const NoteItem& note) { return note.id == id; });
    if (found == notes.end()) return NoteResult::NotFound;
    if (removed_audio_file) *removed_audio_file = found->audio_file;
    notes.erase(found);
    changed();
    return NoteResult::Ok;
}

const NoteItem* NotesModel::find(std::uint32_t id) const noexcept {
    for (const auto& note : snapshot_.notes) {
        if (note.id == id) return &note;
    }
    return nullptr;
}

NoteItem* NotesModel::find_mutable(std::uint32_t id) noexcept {
    for (auto& note : snapshot_.notes) {
        if (note.id == id) return &note;
    }
    return nullptr;
}

std::string NotesModel::context_for(const std::string& question) const {
    if (!question_mentions_notes(question)) return {};
    std::string context;
    for (const auto& note : snapshot_.notes) {
        if (note.text.empty()) continue;
        std::string line = "- ";
        if (note.created_minute > 0) {
            const auto when = from_minute_index(note.created_minute);
            char stamp[32];
            std::snprintf(stamp, sizeof(stamp), "%04d-%02d-%02d %02d:%02d: ", when.year, when.month, when.day,
                          when.hour, when.minute);
            line += stamp;
        }
        std::string text = note.text;
        std::replace(text.begin(), text.end(), '\n', ' ');
        line += text;
        line += '\n';
        if (context.size() + line.size() > kContextBytes) break;
        context += line;
    }
    return context;
}

std::string NotesModel::serialize() const {
    std::ostringstream output;
    output << "aura-notes 1\n" << "N\t" << next_id_ << '\n';
    // Oldest first, so a restore rebuilds the same newest-first order.
    for (auto note = snapshot_.notes.rbegin(); note != snapshot_.notes.rend(); ++note) {
        output << "T\t" << note->id << '\t' << note->created_minute << '\t' << note->audio_ms << '\t'
               << static_cast<int>(note->transcript) << '\t' << note->audio_file << '\t'
               << escape_line(note->text) << '\n';
    }
    return output.str();
}

bool NotesModel::restore(const std::string& data) {
    std::istringstream input(data);
    std::string line;
    if (!std::getline(input, line) || line != "aura-notes 1") return false;
    std::vector<NoteItem> notes;
    std::uint32_t next_id = 1;
    while (std::getline(input, line)) {
        std::vector<std::string> fields;
        std::size_t start = 0;
        for (int index = 0; index < 6; ++index) {
            const auto tab = line.find('\t', start);
            if (tab == std::string::npos) break;
            fields.push_back(line.substr(start, tab - start));
            start = tab + 1;
        }
        fields.push_back(line.substr(start));
        std::int64_t values[4]{};
        if (fields.size() == 2 && fields[0] == "N" && parse_number(fields[1], values[0]) && values[0] < 0x7FFFFFFF) {
            next_id = std::max(next_id, static_cast<std::uint32_t>(values[0]));
            continue;
        }
        if (fields.size() != 7 || fields[0] != "T" || notes.size() >= kMaxNotes) continue;
        bool ok = true;
        for (int index = 0; index < 4; ++index) ok = ok && parse_number(fields[static_cast<std::size_t>(index) + 1], values[index]);
        if (!ok || values[0] <= 0 || values[0] >= 0x7FFFFFFF || values[3] > 3 || !safe_audio_name(fields[5])) continue;
        NoteItem note;
        note.id = static_cast<std::uint32_t>(values[0]);
        note.created_minute = values[1];
        note.audio_ms = static_cast<std::uint32_t>(std::min<std::int64_t>(values[2], 600000));
        note.transcript = static_cast<NoteTranscript>(values[3]);
        // A transcription interrupted by a restart is not retried silently.
        if (note.transcript == NoteTranscript::Pending) note.transcript = NoteTranscript::Failed;
        note.audio_file = fields[5];
        note.text = sanitize_text(unescape_line(fields[6]), kMaxTextBytes, true);
        if (note.text.empty() && note.audio_file.empty()) continue;
        next_id = std::max(next_id, note.id + 1);
        notes.insert(notes.begin(), std::move(note));
    }
    snapshot_.notes = std::move(notes);
    next_id_ = std::max(next_id_, next_id);
    changed();
    return true;
}

bool question_mentions_notes(const std::string& question) {
    const auto folded = fold_text(question);
    return folded_contains_any(folded, {"σημειωσ", "σημειωμ", "σημειωσα", "σημειωνα", "note", "notes", "memo"});
}

std::string voice_note_file_name(std::int64_t minute, std::uint32_t counter, std::uint32_t nonce) {
    char name[64];
    std::snprintf(name, sizeof(name), "note-%lld-%lu-%08lx.wav", static_cast<long long>(std::max<std::int64_t>(minute, 0)),
                  static_cast<unsigned long>(counter), static_cast<unsigned long>(nonce));
    return name;
}

bool NoteTranscriptions::start(std::uint32_t note, std::future<TranscriptResult> job, NotesModel& notes) {
    if (jobs_.size() >= kMaxPending || !job.valid()) {
        notes.set_transcript_failed(note);
        return false;
    }
    jobs_.push_back({note, std::move(job)});
    return true;
}

void NoteTranscriptions::poll(NotesModel& notes) {
    for (auto job = jobs_.begin(); job != jobs_.end();) {
        if (job->result.wait_for(std::chrono::milliseconds(0)) != std::future_status::ready) {
            ++job;
            continue;
        }
        const auto result = job->result.get();
        if (result.ok) notes.set_transcript(job->note, result.text);
        else notes.set_transcript_failed(job->note);
        job = jobs_.erase(job);
    }
}

std::vector<std::future<TranscriptResult>> NoteTranscriptions::release() {
    std::vector<std::future<TranscriptResult>> pending;
    for (auto& job : jobs_) pending.push_back(std::move(job.result));
    jobs_.clear();
    return pending;
}

}  // namespace aura
